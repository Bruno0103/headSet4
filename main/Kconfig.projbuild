## main/Kconfig.projbuild
```kconfig
menu "Headset"

    config HEADSET_DEVICE_NAME
        string "Nome Bluetooth Classic do headset"
        default "Headphone"

    config HEADSET_BLE_DEVICE_NAME
        string "Nome Bluetooth Low Energy (BLE) do headset"
        default "Headphone BLE"

    config HEADSET_FACTORY_RESET_ON_BOOT
        bool "Apagar particao NVS a cada boot (Factory Reset)"
        default n
        help
            Se ativado, apaga toda a particao NVS (nvs_flash_erase) a cada inicializacao.
            CUIDADO: Isso apagara todos os dados persistidos, como pareamentos Bluetooth,
            configuracoes de equalizador (EQ), volumes e chaves salvas.
            Mantenha desativado (n) em operacao normal para preservar os estados.

    menu "Sensor de proximidade (APDS-9930)"
        config HEADSET_APDS_ON_THRESHOLD
            int "Colocado: leitura >= (nivel sem nada perto + valor)"
            range 1 1023
            default 200

        config HEADSET_APDS_OFF_THRESHOLD
            int "Retirado: leitura <= (nivel sem nada perto + valor); deve ser < o de colocado"
            range 0 1022
            default 120

        config HEADSET_APDS_DEBOUNCE_MS
            int "Debounce (ms) para confirmar a mudanca"
            range 50 2000
            default 300

        config HEADSET_APDS_POLL_MS
            int "Periodo de leitura (ms)"
            range 20 5000
            default 100

        config HEADSET_APDS_DUTY_CYCLE
            bool "Desligar o sensor (PON=0) entre as leituras para economizar energia"
            default y
            help
                A cada leitura o sensor e ligado, espera ~15 ms por uma medida valida e volta a dormir.
                Aumente o periodo de leitura para economizar mais (o debounce continua em ms).

        config HEADSET_APDS_LOG_PERIOD_MS
            int "Periodo do log com a leitura bruta (ms; 0 = desligado) - util para ajustar os limiares"
            range 0 60000
            default 1000
    endmenu

    menu "Google Fast Pair"
        config HEADSET_FASTPAIR_MODEL_ID
            string "Model ID (3 bytes em hexa, ex.: 209865) - do Google Nearby Console"
            default "209865"
            help
                Identificador de 3 bytes (0x209865) registrado no Google Nearby Console.
                Deixe vazio para DESATIVAR o Fast Pair (o headset segue com pareamento
                Classic manual). A imagem do pop-up e configurada no console, nao aqui.
                Configure no sdkconfig local ou grave via NVS.

        config HEADSET_FASTPAIR_ANTISPOOF_PRIVATE_KEY_B64
            string "Anti-Spoofing PRIVATE key (Base64, 32 bytes) - do Nearby Console"
            default "W9Ff/5Y6pNI3A5QBnamnuALyDQLvw9rYEwG2OfzWPQ0="
            help
                Segredo do produto (32 bytes em Base64, secp256r1) para ECDH Anti-Spoofing.
                Fica EXCLUSIVAMENTE no sdkconfig local (ignorado pelo git) ou gravado via NVS.
                NUNCA versione este valor no repositório Git.
    endmenu

    menu "Microsoft Swift Pair"
        config HEADSET_SWIFT_PAIR_ENABLE
            bool "Habilitar Microsoft Swift Pair no Advertising principal"
            default y
            help
                Emite o payload do Microsoft Swift Pair (Company ID 0x0006) no pacote
                de Advertising principal (ADV_IND) durante a janela de pareamento (PAIRING).
                Permite que o Windows 10/11 exiba a notificacao automatica (toast popup)
                para emparelhamento rapido em conjunto com o Google Fast Pair.

        config HEADSET_SWIFT_PAIR_RSSI_THRESHOLD
            hex "RSSI threshold byte (padrao 0x80 para deteccao sem filtro estrito)"
            range 0x00 0xFF
            default 0x80
            depends on HEADSET_SWIFT_PAIR_ENABLE
            help
                Valor de RSSI threshold conforme especificacao da Microsoft Swift Pair Beacon.
                0x80 e o padrao recomendado pela Microsoft para aceitar pareamento sem restricoes severas de RSSI.
    endmenu

    menu "Display e Touch Screen"
        config HEADSET_TOUCH_DIAG
            bool "Habilitar logs de diagnostico do touch screen (XPT2046)"
            default n
            help
                Ativa o envio de logs periodicos de diagnostico e eventos de toque
                do sensor resistivo XPT2046 via console serial.
                Quando desabilitado, suprime a impressao continua de diagnostico
                para poupar CPU e evitar poluicao do log serial.
    endmenu

endmenu
```
